## CMakeLists.txt
```
#
# Copyright (c) 2018 Nordic Semiconductor
#
# SPDX-License-Identifier: LicenseRef-Nordic-5-Clause
#
cmake_minimum_required(VERSION 3.20.0)

find_package(Zephyr REQUIRED HINTS $ENV{ZEPHYR_BASE})
project(NONE)

# NORDIC SDK APP START
target_sources(app PRIVATE
  src/main.c
  src/my_sensor.c
)

# NORDIC SDK APP END
zephyr_library_include_directories(.)
```

## prj.conf
```kconfig
#
# Copyright (c) 2018 Nordic Semiconductor
#
# SPDX-License-Identifier: LicenseRef-Nordic-5-Clause
#

# Logger module
CONFIG_LOG=y

# Button and LED library
CONFIG_DK_LIBRARY=y

# Bluetooth LE
CONFIG_BT=y
CONFIG_BT_PERIPHERAL=y
CONFIG_BT_DEVICE_NAME="MY_LBS2"

# Increase stack size for the main thread and System Workqueue
CONFIG_SYSTEM_WORKQUEUE_STACK_SIZE=2048
CONFIG_MAIN_STACK_SIZE=2048

CONFIG_STDOUT_CONSOLE=y
CONFIG_SENSOR=y
CONFIG_DHT=y  # Correct driver symbol
CONFIG_GPIO=y
CONFIG_SENSOR_LOG_LEVEL_DBG=y

# Memory management (critical)
CONFIG_HEAP_MEM_POOL_SIZE=8192
CONFIG_MAIN_STACK_SIZE=2048
```

## boards/nrf52840dk_nrf52840.overlay
```dts
/* boards/nrf52840dk_nrf52840.overlay */

/ {
     aliases {
         /* so in code you can do DEVICE_DT_GET(DT_ALIAS(dht11)) */
         dht11 = &dht11_node;
         //the above line is doing the following things
            //1. It creates an alias named "dht11" that points to the dht11_node.
            //2. It allows you to access the DHT11 sensor node using the alias "dht11" in your code.
     };
 };

 &gpio0 {
     /* Attach DHT11 on P0.31 */
     dht11_node: dht11 {
    compatible = "aosong,dht";  // ✅ Matches DT_DRV_COMPAT
  // Match driver binding
    dio-gpios = <&gpio0 31 (GPIO_OPEN_DRAIN | GPIO_PULL_UP | GPIO_ACTIVE_LOW)>; 
    //the above line is  doing the following things:
    //1. It specifies the GPIO pin (P0.31) used for data communication with the DHT11 sensor.
    //2. It configures the pin as an open-drain output with a pull-up resistor and active-low logic.
    //This means that the pin can pull low to signal data, and it will be pulled
    //high when not actively driving the line.
    //This configuration is typical for DHT11 sensors, which use a single-wire protocol for
    //communication.
    //The pin is configured to be open-drain, which means it can either pull the
    //line low or leave it floating (high) when not transmitting data.
    //The pull-up resistor ensures that the line is high when not being driven low by the
    //DHT11 sensor.
    //The active-low configuration means that a low signal on this pin indicates data being sent
    //from the DHT11 sensor to the microcontroller.


    label = "DHT11";
};
 };
```

## src/main.c
```c
/*
 * lesson4_exercise2_commented.c
 *
 * Zephyr application: Custom MySensor Service example.
 * Sends simulated 32-bit sensor data via BLE notifications using a custom GATT characteristic.
 * Includes detailed inline comments explaining every macro, function, and flow.
 */

#include <zephyr/kernel.h>
#include <zephyr/logging/log.h>
#include <zephyr/bluetooth/bluetooth.h>
#include <zephyr/bluetooth/gap.h>
#include <zephyr/bluetooth/uuid.h>
#include <zephyr/bluetooth/conn.h>
#include <dk_buttons_and_leds.h>
#include <zephyr/device.h>
#include <zephyr/drivers/sensor.h>
#include <zephyr/sys/printk.h>
#include <zephyr/devicetree.h>
#include <stdio.h>

/* Include header for our custom MySensor GATT service */
#include "my_sensor.h"  // You may want to rename this to my_sensor.h to match the new structure

LOG_MODULE_REGISTER(Lesson4_Exercise2, LOG_LEVEL_INF);

/*
 * Advertising parameters:
 * - Connectable advertising
 * - Uses identity address
 * - Advertising interval: 500 ms
 */
static const struct bt_le_adv_param *adv_param = BT_LE_ADV_PARAM(
    (BT_LE_ADV_OPT_CONNECTABLE | BT_LE_ADV_OPT_USE_IDENTITY),
    800, 801, NULL);
/*Explain the above line 800 and 801 are the minimum and maximum advertising intervals in 0.625 ms units.
 * 800 * 0.625 ms = 500 ms, so this sets the advertising interval to 500 ms.
 */

/* GAP device name from Kconfig */
#define DEVICE_NAME CONFIG_BT_DEVICE_NAME
#define DEVICE_NAME_LEN (sizeof(DEVICE_NAME) - 1)

/* LEDs */
#define RUN_STATUS_LED DK_LED1     // Blinks to indicate system is running
#define CON_STATUS_LED DK_LED2     // Indicates active BLE connection

/* Thread stack size and priority */
#define STACKSIZE 1024
#define PRIORITY 7

/* Blink interval and sensor notification interval */
#define RUN_LED_BLINK_INTERVAL 1000

/* Alias we defined in the overlay */
#define DHT11_NODE DT_ALIAS(dht11)

#if !DT_NODE_HAS_STATUS(DHT11_NODE, okay)
#error "DHT11 devicetree alias is not defined or status is not 'okay'"
#endif

/* Work queue item for advertising */
static struct k_work adv_work;

/* Advertising payload: flags and complete name */
static const struct bt_data ad[] = {
    BT_DATA_BYTES(BT_DATA_FLAGS, (BT_LE_AD_GENERAL | BT_LE_AD_NO_BREDR)),
    BT_DATA(BT_DATA_NAME_COMPLETE, DEVICE_NAME, DEVICE_NAME_LEN),
};

/* Scan response payload: include our custom MySensor service UUID */
static const struct bt_data sd[] = {
    BT_DATA_BYTES(BT_DATA_UUID128_ALL,
        BT_UUID_128_ENCODE(0x12345678, 0x9abc, 0xdef0, 0x1234, 0x56789abcdef0)),
    // This UUID matches BT_UUID_MYSENSOR_SERVICE used in GATT declaration
};

/* Advertising work handler */
static void adv_work_handler(struct k_work *work)
{
    int err = bt_le_adv_start(adv_param, ad, ARRAY_SIZE(ad), sd, ARRAY_SIZE(sd));
    if (err) {
        printk("Advertising failed to start (err %d)\n", err);
        return;
    }
    printk("Advertising successfully started\n");
}

/* Helper to start advertising */
static void advertising_start(void)
{
    k_work_submit(&adv_work);
}

/* Called when old connection object is recycled */
static void recycled_cb(void)
{
    printk("Recycled connection object: restarting advertising\n");
    advertising_start();
}

/* Thread function to send sensor data via notification periodically */
void dht11_notify_thread(void)
{
    const struct device *dht = DEVICE_DT_GET(DHT11_NODE);

    if (!device_is_ready(dht)) {
        printk("DHT11 device not ready\n");
        return;
    }

    struct sensor_value temp, hum;
    char data_str[20];  // Enough for "100C | 100%\0"

    while (1) {
        if (sensor_sample_fetch(dht) == 0) 
        {
            sensor_channel_get(dht, SENSOR_CHAN_AMBIENT_TEMP, &temp);
            sensor_channel_get(dht, SENSOR_CHAN_HUMIDITY, &hum);

            snprintf(data_str, sizeof(data_str), "%dC | %d%%", temp.val1, hum.val1);
            printk("Sending: %s\n", data_str);

            int err = my_sensor_notify_string(data_str);
            if (err == -EACCES) {
                printk("Notification not enabled by central.\n");
            } else if (err) {
                printk("Notification sent!\n");
            }
        } 
        else 
        {
            printk("Sample fetch failed\n");
        }

        k_sleep(K_MSEC(2000));
    }
}

/* Connection callback: connected */
static void on_connected(struct bt_conn *conn, uint8_t err)
{
    if (err) {
        printk("Connection failed (err %u)\n", err);
        return;
    }
    printk("Connected\n");
    dk_set_led_on(CON_STATUS_LED);
}

/* Connection callback: disconnected */
static void on_disconnected(struct bt_conn *conn, uint8_t reason)
{
    printk("Disconnected (reason %u)\n", reason);
    dk_set_led_off(CON_STATUS_LED);
}

/* Register BLE connection callbacks */
static struct bt_conn_cb connection_callbacks = {
    .connected    = on_connected,
    .disconnected = on_disconnected,
    .recycled     = recycled_cb,
};

/* Entry point */
int main(void)
{
    int err;
    int blink_state = 0;

    /* Initialize LED control */
    err = dk_leds_init();
    if (err) {
        LOG_ERR("LEDs init failed (err %d)\n", err);
        return -1;
    }

    /* Enable Bluetooth */
    err = bt_enable(NULL);
    if (err) {
        LOG_ERR("Bluetooth init failed (err %d)\n", err);
        return -1;
    }

    /* Register connection callbacks */
    bt_conn_cb_register(&connection_callbacks);

    LOG_INF("Bluetooth initialized\n");

    /* Initialize advertising work and start it */
    k_work_init(&adv_work, adv_work_handler);
    advertising_start();

    /* Blink LED to show device is alive */
    while (1) {
        dk_set_led(RUN_STATUS_LED, (++blink_state) % 2);
        k_sleep(K_MSEC(RUN_LED_BLINK_INTERVAL));
    }
}

   /* Launch a thread to periodically send sensor data */
    K_THREAD_DEFINE(dht11_thread_id,
                STACKSIZE,
                dht11_notify_thread,
                NULL, NULL, NULL,
                PRIORITY,
                0,
                0);
```

## src/my_sensor.c
```c
/*
 * my_sensor_service.c
 *
 * Custom MySensor Bluetooth Service implementation with explanatory comments.
 * Defines a GATT service containing a notify-only characteristic for sending
 * sensor data to a connected central device.
 *
 * SPDX-License-Identifier: LicenseRef-Nordic-5-Clause
 */

#include <zephyr/types.h>           // Standard types: u8_t, u32_t
#include <stddef.h>                 // NULL, size_t
#include <string.h>                 // memcpy, memset
#include <errno.h>                  // Error codes like -EACCES
#include <zephyr/sys/printk.h>      // printk for debug output
#include <zephyr/kernel.h>          // Kernel utilities
#include <zephyr/logging/log.h>     // Logging macros
#include <zephyr/bluetooth/bluetooth.h>  // Bluetooth API
#include <zephyr/bluetooth/conn.h>       // Connection management
#include <zephyr/bluetooth/gatt.h>       // GATT service API
#include "my_sensor.h"              // Header with UUIDs and notify API

LOG_MODULE_DECLARE(Lesson4_Exercise2);

// Flag to track if notifications are enabled
static bool notify_mysensor_enabled;

/*
 * Called when central enables/disables notifications for MySensor.
 */
static void ccc_cfg_changed_handler(const struct bt_gatt_attr *attr, uint16_t value)
{
    notify_mysensor_enabled = (value == BT_GATT_CCC_NOTIFY);
}

/*
 * GATT service declaration for MySensor.
 * Contains:
 * - Primary Service UUID
 * - One Notify-only Characteristic with CCC descriptor
 */
BT_GATT_SERVICE_DEFINE(my_sensor_service, // Define a GATT service instance named 'my_sensor_service'

    // Primary service declaration with custom 128-bit UUID
    BT_GATT_PRIMARY_SERVICE(BT_UUID_MYSENSOR_SERVICE),

    // Characteristic declaration:
    // - UUID: BT_UUID_MYSENSOR_CHARACTERISTIC
    // - Properties: Notify only
    // - Permissions: No read/write from client
    // - NULL read/write callbacks (since it's notify-only)
    BT_GATT_CHARACTERISTIC(
        BT_UUID_MYSENSOR_CHARACTERISTIC,
        BT_GATT_CHRC_NOTIFY,         // Allows notifications to be sent
        BT_GATT_PERM_NONE,           // No client-side read/write access
        NULL, NULL, NULL),           // No read/write callbacks needed

    // Client Characteristic Configuration Descriptor (CCCD):
    // - Lets central device enable/disable notifications
    // - Triggers 'ccc_cfg_changed_handler' on write
    BT_GATT_CCC(ccc_cfg_changed_handler,
                BT_GATT_PERM_READ | BT_GATT_PERM_WRITE),
);


/*
 * Sends a string sensor value to the central via notification.
 * Central must have subscribed by writing to CCC.
 */

int my_sensor_notify_string(const char *sensor_str)
{
    if (!notify_mysensor_enabled) {
        return -EACCES;
    }

    return bt_gatt_notify(NULL,
                          &my_sensor_service.attrs[2],
                          sensor_str,
                          strlen(sensor_str));
}
```

## src/my_sensor.h
```c
/*
 * my_sensor.h
 *
 * Header file for the custom MySensor Bluetooth Low Energy (BLE) service.
 * This service provides a notify-only characteristic used to send sensor data
 * (e.g., temperature or any 32-bit sensor value) to a connected central device.
 *
 * SPDX-License-Identifier: LicenseRef-Nordic-5-Clause
 */

#ifndef MY_SENSOR_H_
#define MY_SENSOR_H_

#ifdef __cplusplus
extern "C" {
#endif

#include <zephyr/types.h>
/*
 * Standard Zephyr type definitions (e.g., uint32_t, bool).
 */

/*
 * ===== Custom UUID Definitions =====
 * These UUIDs are 128-bit and uniquely identify the MySensor service and characteristic.
 */

// Custom 128-bit UUID for the MySensor GATT Service
#define BT_UUID_MYSENSOR_SERVICE \
    BT_UUID_DECLARE_128(BT_UUID_128_ENCODE(0x12345678, 0x9abc, 0xdef0, 0x1234, 0x56789abcdef0))

// Custom 128-bit UUID for the notify-only characteristic within MySensor Service
#define BT_UUID_MYSENSOR_CHARACTERISTIC \
    BT_UUID_DECLARE_128(BT_UUID_128_ENCODE(0x12345679, 0x9abc, 0xdef0, 0x1234, 0x56789abcdef0))

/**
 * @brief Notify connected central(s) with a 32-bit sensor value.
 *
 * Sends a BLE notification to all connected devices that have enabled
 * notifications on the custom MySensor characteristic.
 *
 * @param[in] sensor_value The 32-bit sensor reading to transmit.
 * @return 0 if the notification was queued successfully,
 *         -EACCES if notifications are not enabled by the client.
 */
int my_sensor_notify_string(const char *sensor_str);


#ifdef __cplusplus
}
#endif

#endif /* MY_SENSOR_H_ */
```
